## conf/layer.conf
```bitbake
# We have a conf and classes directory, add to BBPATH
BBPATH .= ":${LAYERDIR}"

# We have recipes-* directories, add to BBFILES
BBFILES += "${LAYERDIR}/recipes-*/*/*.bb \
	${LAYERDIR}/recipes-*/*/*.bbappend"

BBFILE_COLLECTIONS += "jciq6"
BBFILE_PATTERN_jciq6 = "^${LAYERDIR}/"
BBFILE_PRIORITY_jciq6 = "6"

FSL_EULA_FILE = "${LAYERDIR}/EULA"

FSL_MIRROR ?= "http://www.freescale.com/lgfiles/NMG/MAD/YOCTO/"

MIRRORS += " \
${FSL_MIRROR}	http://download.ossystems.com.br/bsp/freescale/source/ \n \
"

# Let us add layer-specific bbappends which are only applied when that
# layer is included in our configuration
BBFILES += "${@' '.join('${LAYERDIR}/%s/recipes*/*/*.bbappend' % layer \
               for layer in BBFILE_COLLECTIONS.split())}"
# Add layer-specific bb files too
BBFILES += "${@' '.join('${LAYERDIR}/%s/recipes*/*/*.bb' % layer \
               for layer in BBFILE_COLLECTIONS.split())}"
```

## conf/machine/jciq6.conf
```bitbake
#@TYPE: Machine
#@NAME: JCI Q6 Board
#@SOC: i.MX6Q
#@DESCRIPTION: Machine configuration for JCI Q6 Board
#@MAINTAINER: Phil FLournoy <phil@itgembedded.com>

require conf/machine/include/jciq6-common.inc

SOC_FAMILY = "mx6:mx6q"

PREFERRED_PROVIDER_u-boot = "u-boot-jciq6"
PREFERRED_PROVIDER_u-boot_mx6 = "u-boot-jciq6"
PREFERRED_PROVIDER_virtual/bootloader = "u-boot-jciq6"
#UBOOT_MACHINE = "jciq6_defconfig"

PREFERRED_PROVIDER_virtual/kernel_mx6 = "linux-jciq6"
PREFERRED_VERSION_linux-jciq6 ?= "4.1"

KERNEL_DEVICETREE = "imx6q-jciq6.dtb" 

UBOOT_CONFIG ??= "sd"
UBOOT_CONFIG[sd] = "jciq6_config,sdcard"
UBOOT_CONFIG[sata] = "jciq6_sata_config"
UBOOT_CONFIG[mfgtool] = "jciq6_config"
```

## conf/machine/jciq6p.conf
```bitbake
#@TYPE: Machine
#@NAME: JCI Q6 Plus Board
#@SOC: i.MX6QP
#@DESCRIPTION: Machine configuration for JCI Q6 Board
#@MAINTAINER: Phil FLournoy <phil@itgembedded.com>

require conf/machine/include/jciq6-common.inc

SOC_FAMILY = "mx6:mx6q"

PREFERRED_PROVIDER_u-boot_mx6 = "u-boot-jciq6"
PREFERRED_PROVIDER_virtual/kernel_mx6 = "linux-jciq6"
PREFERRED_VERSION_linux-jciq6 ?= "4.1"

KERNEL_DEVICETREE = "imx6qp-jciq6.dtb" 

UBOOT_CONFIG ??= "sd"
UBOOT_CONFIG[sd] = "jciq6p_config,sdcard"
UBOOT_CONFIG[sata] = "jciq6p_sata_config"
UBOOT_CONFIG[mfgtool] = "jciq6p_config"
```
